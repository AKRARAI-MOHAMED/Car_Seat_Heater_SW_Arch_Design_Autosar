AUTOSAR XML (schema 3-2-1)
package /Interfaces
  client server interface IRegulatorPosition
    operation SetPosition
      arg Position: type=Int32, direction=IN
  client server interface IHeaterLevel
    operation SetHeat
      arg LeftHeatLevel: type=Int32, direction=IN
      arg RightHeatLevel: type=Int32, direction=IN
  4 x sender receiver interface:
    ISensorIO
      data SensorValue: type=Boolean
    ISeatStatus
      data PassengerOnSeat: type=Boolean
    IHeaterIO
      data HeaterValue: type=Int32
    IRegulatorIO
      data RegulatorValue: type=Int32
