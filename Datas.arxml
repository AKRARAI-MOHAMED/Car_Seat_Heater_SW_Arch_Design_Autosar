AUTOSAR XML (schema 3-2-1)
standard types defined: Boolean
package /Datas
  integer type Int32: lower-limit=0, upper-limit=1000
